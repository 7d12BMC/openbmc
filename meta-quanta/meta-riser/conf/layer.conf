## meta-quanta/meta-riser/conf/layer.conf
```bitbake
# We have a conf and classes directory, add to BBPATH
BBPATH .= ":${LAYERDIR}"

# We have recipes-* directories, add to BBFILES
BBFILES += "${LAYERDIR}/recipes-*/*/*.bb \
            ${LAYERDIR}/recipes-*/*/*.bbappend"

BBFILE_COLLECTIONS += "riser"
BBFILE_PATTERN_riser = ""
LAYERSERIES_COMPAT_riser = "gatesgarth hardknott"
```
